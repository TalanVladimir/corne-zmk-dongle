number_layer {
    label = "NUMBER";
    display-name = "NUMBER";

    bindings = <
    //╭─────────────┬─────────────┬─────────────┬─────────────┬─────────────┬─────────────╮  ╭─────────────┬─────────────┬─────────────┬─────────────┬─────────────┬─────────────╮
        &kp KP_NLCK   &kp KP_DIVIDE &kp KP_N7     &kp KP_N8     &kp KP_N9     &kp KP_MULTIPLY  &none         &none         &none         &none         &none         &kp BSPC
    //├─────────────┼─────────────┼─────────────┼─────────────┼─────────────┼─────────────┤  ├─────────────┼─────────────┼─────────────┼─────────────┼─────────────┼─────────────┤
        &kp LCTRL     &none         &kp KP_N4     &kp KP_N5     &kp KP_N6     &kp KP_MINUS     &none         &none         &none         &none         &none         &none
    //├─────────────┼─────────────┼─────────────┼─────────────┼─────────────┼─────────────┤  ├─────────────┼─────────────┼─────────────┼─────────────┼─────────────┼─────────────┤
        &kp LALT      &none         &kp KP_N1     &kp KP_N2     &kp KP_N3     &kp KP_PLUS      &none         &kp LEFT      &kp DOWN      &kp UP        &kp RIGHT     &kp DEL
    //╰─────────────┴─────────────┴─────────────┼─────────────┼─────────────┼─────────────┤  ├─────────────┼─────────────┼─────────────┼─────────────┴─────────────┴─────────────╯
                                                  &kp KP_N0     &kp KP_DOT    &kp SPACE        &kp ENTER     &none         &none
    //                                          ╰─────────────┴─────────────┴─────────────╯  ╰─────────────┴─────────────┴─────────────╯
    >;
};