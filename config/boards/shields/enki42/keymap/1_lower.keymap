#define PP C_PLAY_PAUSE
#define SCR_D SCRL_DOWN
#define SCR_U SCRL_UP

lower_layer {
    label = "LOWER";
    display-name = "LOWER";

    bindings = <
    //╭─────────────┬─────────────┬─────────────┬─────────────┬─────────────┬─────────────╮  ╭─────────────┬─────────────┬─────────────┬─────────────┬─────────────┬─────────────╮
        &kp GRAVE   &kp N1       &kp N2       &kp N3       &kp N4         &kp N5             &kp N6      &kp N7      &kp N8      &kp N9    &kp N0      &kp BSPC
    //├─────────────┼─────────────┼─────────────┼─────────────┼─────────────┼─────────────┤  ├─────────────┼─────────────┼─────────────┼─────────────┼─────────────┼─────────────┤
        &kp LCTRL   &mo NUMBER   &tab_prev    &tab_next    &mo EXTRA      &mo UBER           &kp INS     &kp MINUS   &kp EQUAL   &kp LBKT  &kp RBKT    &kp BSLH
    //├─────────────┼─────────────┼─────────────┼─────────────┼─────────────┼─────────────┤  ├─────────────┼─────────────┼─────────────┼─────────────┼─────────────┼─────────────┤
        &kp LSHFT   &to MAUS     &msc SCR_D   &msc SCR_U   &none          &lt PLAYER PP      &none       &kp LEFT    &kp DOWN    &kp UP    &kp RIGHT   &kp DEL
    //╰─────────────┴─────────────┴─────────────┼─────────────┼─────────────┼─────────────┤  ├─────────────┼─────────────┼─────────────┼─────────────┴─────────────┴─────────────╯
                                              &kp LALT     &mo LOWER      &kp SPACE          &kp ENTER   &kp RALT    &kp LGUI
    //                                          ╰─────────────┴─────────────┴─────────────╯  ╰─────────────┴─────────────┴─────────────╯
    >;
};